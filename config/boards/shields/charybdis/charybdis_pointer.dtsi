#include <input/processors.dtsi>
#include <dt-bindings/zmk/input_transform.h>

&zip_temp_layer {
    /* immidiately return from auto mouse layer, if any key excluding below is pressed*/
    excluded-positions = <
        30
        42
        43
        44
        45
        46
    >;
};

&zip_temp_layer {
    /* prevent to invoke auto mouse layer for {200ms} after any key press */
    require-prior-idle-ms = <200>;
};

&trackball_listener {
    /* base processor chain on all layers */
    input-processors = <&zip_xy_scaler 5 5>;

    /* auto mouse layer setting (mouse layer = 3, active time(ms) = 2000)*/
    input-processors = <&zip_temp_layer 3 2000>;

    /* layer-4 scroll override */
    scroller: scroller {
        layers           = <4>;
        input-processors = <
            &zip_xy_scaler 1 10                              // Scales the scroll speed
            &zip_scroll_scaler 1 3
            &zip_xy_to_scroll_mapper                         // Converts XY movement to scroll events
            &zip_scroll_transform (INPUT_TRANSFORM_Y_INVERT) // Inverts the scroll direction
        >;
    };

    /* layer-7 slow-pointer override */
    slow_pointer: slow_pointer {
        layers           = <6>;
        input-processors = <&zip_xy_scaler 2 6>;
    };
};